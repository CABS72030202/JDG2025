## config/buildroot/Config.in
```kconfig
menu "JDG2025 custom packages"

source "package/jdg2025/package/jdg_blackbox/Config.in"
source "package/jdg2025/package/jdg_controller/Config.in"
source "package/jdg2025/package/jdg_mini_rpi/Config.in"

endmenu
```

## config/buildroot/package/jdg_blackbox/Config.in
```kconfig
config BR2_PACKAGE_JDG_BLACKBOX
    bool "blackbox"
    help
      Build the JDG custom blackbox package.
```

## config/buildroot/package/jdg_controller/Config.in
```kconfig
config BR2_PACKAGE_JDG_CONTROLLER
    bool "controller"
    help
      Build the controller package.
```

## config/buildroot/package/jdg_mini_rpi/Config.in
```kconfig
config BR2_PACKAGE_JDG_MINI_RPI
    bool "mini_rpi"
    help
      Build the mini_rpi package.
```

## config/buildroot/package/jdg_wiringPi/Config.in
```kconfig
config BR2_PACKAGE_JDG_WIRINGPI
    bool "WiringPi"
    help
      WiringPi is a GPIO library for the Raspberry Pi.
      It provides access to the GPIO pins, I2C, SPI, and UART interfaces.

      https://github.com/WiringPi/WiringPi
```
